## boards/shields/tekaysplit/Kconfig.shield
```kconfig
config SHIELD_TEKAYSPLIT_RIGHT
    def_bool $(shields_list_contains,tekaysplit_right)

config SHIELD_TEKAYSPLIT_LEFT
    def_bool $(shields_list_contains,tekaysplit_left)
```
