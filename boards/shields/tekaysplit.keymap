#include <dt-bindings/zmk/keys.h>

/ {
    keymap {
        compatible: "zmk,keymap";
        
        base_layer {
            &kp EQUAL &kp N1    &kp N2    &kp N3    &kp N4    &kp N5    &none                         &none     &kp N6    &kp N7    &kp N8    &kp N9    &kp N10   &kp MINUS
            &kp TAB   &kp Q     &kp W     &kp E     &kp R     &kp T     &none     &none     &none     &none     &kp Y     &kp U     &kp I     &kp O     &kp P     &kp BSLH
            &kp ESC   &kp A     &kp S     &kp D     &kp F     &kp G     &none     &kp LALT  &kp RGUI  &none     &kp H     &kp J     &kp K     &kp L     &kp SEMI  &kp SQT
            &kp CAPS  &kp Z     &kp X     &kp C     &kp V     &kp B     &kp LCTRL &kp HOME  &kp PG_UP &kp RCTRL &kp N     &kp M     &kp COMMA &kp DOT   &kp SLASH &kp RSHFT
            &none     &kp GRAVE &kp NUBS  &kp LEFT  &kp RIGHT &kp BSPC  &kp DEL   &kp END   &kp PG_DN &kp ENTER &kp SPACE &kp UP    &kp DOWN  &kp LBKT  &kp RBKT  &none
        };
    };
};